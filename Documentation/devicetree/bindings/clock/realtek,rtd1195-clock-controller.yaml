## arch/arm/mach-realtek/Kconfig
```kconfig
# SPDX-License-Identifier: GPL-2.0-or-later
menuconfig ARCH_REALTEK
	bool "Realtek SoCs"
	depends on ARCH_MULTI_V7
	select ARM_ERRATA_814220
	select ARM_GIC
	select ARM_GLOBAL_TIMER
	select CLKSRC_ARM_GLOBAL_TIMER_SCHED_CLOCK
	select GENERIC_IRQ_CHIP
	select RESET_CONTROLLER
	help
	  This enables support for the Realtek RTD1195 SoC family.

	  RTD1195 is a Cortex-A7 r0p5 part, one of the revisions (r0p2-r0p5)
	  affected by erratum 814220 (L2 set/way cache maintenance can
	  overtake L1). The erratum itself isn't SMP-specific - it can bite
	  any full cache flush, single core or not - but on this board it
	  surfaced as an intermittent early-boot memory corruption tied to
	  CPU1 coming up under heavy concurrent vmalloc/vmap_area churn
	  (systemd + friends), so ARM_ERRATA_814220 is force-selected here
	  rather than left as an opt-in.
```

## drivers/clk/realtek/Kconfig
```kconfig
config COMMON_CLK_REALTEK
	bool "Clock driver for realtek"
	select RESET_CONTROLLER

config COMMON_CLK_RTD119X
	bool "Clock driver for RTD119x"
	select COMMON_CLK_REALTEK
	default y if ARCH_REALTEK
```

## drivers/phy/realtek/Kconfig
```kconfig
# SPDX-License-Identifier: GPL-2.0
#
# Phy drivers for Realtek platforms
#

if ARCH_REALTEK || RTK_PLATFORM || COMPILE_TEST

config PHY_RTK_RTD_USB2PHY
	tristate "Realtek RTD USB2 PHY Transceiver Driver"
	depends on USB_SUPPORT
	select GENERIC_PHY
	select USB_PHY
	select USB_COMMON
	help
	  Enable this to support Realtek SoC USB2 phy transceiver.
	  The DHC (digital home center) RTD series SoCs used the Synopsys
	  DWC3 USB IP. This driver will do the PHY initialization
	  of the parameters.

config PHY_RTK_RTD_USB3PHY
	tristate "Realtek RTD USB3 PHY Transceiver Driver"
	depends on USB_SUPPORT
	select GENERIC_PHY
	select USB_PHY
	select USB_COMMON
	help
	  Enable this to support Realtek SoC USB3 phy transceiver.
	  The DHC (digital home center) RTD series SoCs used the Synopsys
	  DWC3 USB IP. This driver will do the PHY initialization
	  of the parameters.

config PHY_RTK_RTD_RLE0599PHY
	tristate "Realtek RTD RLE0599 USB2 PHY Transceiver Driver"
	depends on USB_SUPPORT
	select GENERIC_PHY
	help
	  Enable this to support the Realtek RLE0599 USB2 phy transceiver
	  used as the companion PHY for the SoC's EHCI/OHCI host controller
	  port on RTD119x/RTD129x.

endif # ARCH_REALTEK || RTK_PLATFORM || COMPILE_TEST
```

## drivers/pinctrl/realtek/Kconfig
```kconfig
# SPDX-License-Identifier: GPL-2.0-or-later

config PINCTRL_RTD
	tristate "Realtek DHC core pin controller driver"
	depends on ARCH_REALTEK
	default y
	select PINMUX
	select GENERIC_PINCONF
	select REGMAP_MMIO

config PINCTRL_RTD1619B
	tristate "Realtek DHC 1619B pin controller driver"
	depends on PINCTRL_RTD
	default y

config PINCTRL_RTD1319D
	tristate "Realtek DHC 1319D pin controller driver"
	depends on PINCTRL_RTD
	default y

config PINCTRL_RTD1315E
	tristate "Realtek DHC 1315E pin controller driver"
	depends on PINCTRL_RTD
	default y

config PINCTRL_RTD1195
	tristate "Realtek DHC 1195 pin controller driver"
	depends on PINCTRL_RTD
	default y
	help
	  This option enables the pin controller driver for the CRT and
	  ISO pin muxes on the Realtek RTD1195 SoC, sharing the generic
	  Realtek DHC pin controller core (PINCTRL_RTD) with the driver
	  for the later RTD1315E/RTD1319D/RTD1619B SoCs.
```

## drivers/soc/realtek/Kconfig
```kconfig
config RTD119X
	bool "Realtek RTD119X SoC family specific drivers"
	depends on ARCH_REALTEK
	default y
	help
	  Realtek RTD119X SoC family specific support.

	  If unsure, say N.

if RTD119X
source "drivers/soc/realtek/rtd119x/Kconfig"
endif
```

## drivers/soc/realtek/common/Kconfig
```kconfig
config RTK_SB2_SECURITY_DEBG
	bool "Realtek system bridge security mode debug"
	depends on HAVE_ARM_SMCCC
	default n
	help
	  Enable helper functions for Realtek system bridge security mode debug. If unsure, say N.

config RTK_RBUS_BARRIER
	bool "Realtek rbus barrier"
	depends on RTK_MEM_REMAP
	default y
	help
	  Enable helper functions for R-bus barrier. If unsure, say N.

config RTK_MEM_REMAP
	bool "Realtek memory remap"
	default y
	help
	  Enable helper functions for static ioremap. If unsure, say N.

config RTK_ACPU_RELOAD
	bool "Realtek dynamic ACPU reload"
	default n
	help
	  Dynamic ACPU stop/start mechanism. If unsure, say N.

config RTK_IPCSHM_RESET
	bool "Dynamic IPC share memory reset"
	depends on RTK_ACPU_RELOAD
	default n
	help
	  Reset IPC_SHM when performing dynamic ACPU stop/start. If unsure, say N.

config RTK_VMX_ULTRA
	bool "VMX ultra boot enable"
	default n
	select RTK_VMX_DRM
	help
	  Set VMX ultra boot enable.

config RTK_VMX_DRM
	bool "VMX DRM"
	default n
	help
	  Enable VMX DRM.

source "drivers/soc/realtek/common/rpc/Kconfig"
source "drivers/soc/realtek/common/perfcnt/Kconfig"
```

## drivers/soc/realtek/rtd119x/Kconfig
```kconfig
config SCPU_SRAMCTL_RTD119X
	bool "SCPU Wraper SRAM Control"
	default y if ARCH_REALTEK
```

## drivers/staging/android/Kconfig
```kconfig
# SPDX-License-Identifier: GPL-2.0
menu "Android"

source "drivers/staging/android/ion/Kconfig"

config ANDROID_LOGGER
	tristate "Android log driver"
	default n
	help
	  Enable Android-style logging support.

endmenu
```

## drivers/thermal/realtek/Kconfig
```kconfig
config RTK_THERMAL
	bool "Realtek thermal management"
	depends on OF && THERMAL_OF
	help
	  Enable thermal management with a generic thermal
	  sensor driver on Realtek SoCs.

	  If you want this support, you should say Y here.

config RTK_THERMAL_RTD119X
	bool "RTD-119X thermal sensor support"
	default y if ARCH_REALTEK
	select RTK_THERMAL
```
