## Documentation/devicetree/bindings/clock/realtek,rtd1195-clock-controller.yaml
```yaml
# SPDX-License-Identifier: (GPL-2.0-only OR BSD-2-Clause)
%YAML 1.2
---
$id: http://devicetree.org/schemas/clock/realtek,rtd1195-clock-controller.yaml#
$schema: http://devicetree.org/meta-schemas/core.yaml#

title: Realtek RTD1195 clock controller

maintainers:
  - Stephan Eicher <stephan.eicher@web.de>

description:
  The PLLs and their post-dividers, including the one feeding the CPU. All
  of them derive from the 27MHz crystal.

properties:
  compatible:
    const: realtek,rtd1195-clock-controller

  reg:
    maxItems: 1

  "#clock-cells":
    const: 1
    description:
      Index of the clock, from dt-bindings/clock/rtk,clock-rtd119x.h

required:
  - compatible
  - reg
  - "#clock-cells"

additionalProperties: false

examples:
  - |
    clock-controller@18000000 {
        compatible = "realtek,rtd1195-clock-controller";
        reg = <0x18000000 0x1000>;
        #clock-cells = <1>;
    };
```

## Documentation/devicetree/bindings/clock/realtek,rtd1195-clock-gate-controller.yaml
```yaml
# SPDX-License-Identifier: (GPL-2.0-only OR BSD-2-Clause)
%YAML 1.2
---
$id: http://devicetree.org/schemas/clock/realtek,rtd1195-clock-gate-controller.yaml#
$schema: http://devicetree.org/meta-schemas/core.yaml#

title: Realtek RTD1195 clock gates

maintainers:
  - Stephan Eicher <stephan.eicher@web.de>

description:
  One register whose bits each gate a peripheral clock. Which bit gates
  what is given by clock-output-names, in bit order, with an empty string
  where a bit is unused.

properties:
  compatible:
    const: realtek,rtd1195-clock-gate-controller

  reg:
    maxItems: 1

  "#clock-cells":
    const: 1
    description: bit number within the register

  clock-output-names:
    minItems: 1
    maxItems: 32

required:
  - compatible
  - reg
  - "#clock-cells"
  - clock-output-names

additionalProperties: false

examples:
  - |
    clock-controller@1800000c {
        compatible = "realtek,rtd1195-clock-gate-controller";
        reg = <0x1800000c 0x4>;
        #clock-cells = <1>;
        clock-output-names = "", "hdmirx", "", "gspi";
    };
```

## Documentation/devicetree/bindings/crypto/realtek,rtd1195-mcp.yaml
```yaml
# SPDX-License-Identifier: (GPL-2.0-only OR BSD-2-Clause)
%YAML 1.2
---
$id: http://devicetree.org/schemas/crypto/realtek,rtd1195-mcp.yaml#
$schema: http://devicetree.org/meta-schemas/core.yaml#

title: Realtek MCP crypto accelerator

maintainers:
  - Stephan Eicher <stephan.eicher@web.de>

description:
  The MCP (Media Content Protection) engine in the Realtek RTD1195 SoC
  performs AES over a descriptor ring. Only the AES-128 ECB and CBC modes
  are described here; the driver falls back to software for other key
  sizes.

properties:
  compatible:
    const: realtek,rtd1195-mcp

  reg:
    maxItems: 1

  interrupts:
    maxItems: 1

  clocks:
    maxItems: 1

  resets:
    maxItems: 1

required:
  - compatible
  - reg
  - clocks
  - resets

additionalProperties: false

examples:
  - |
    crypto@18015000 {
        compatible = "realtek,rtd1195-mcp";
        reg = <0x18015000 0x1000>;
        interrupts = <0 2 4>;
        clocks = <&clk_en_1 6>;
        resets = <&rst_1 5>;
    };
```

## Documentation/devicetree/bindings/hwmon/qnap,ts228-pic.yaml
```yaml
# SPDX-License-Identifier: (GPL-2.0-only OR BSD-2-Clause)
%YAML 1.2
---
$id: http://devicetree.org/schemas/hwmon/qnap,ts228-pic.yaml#
$schema: http://devicetree.org/meta-schemas/core.yaml#

title: QNAP TS-228 front-panel PIC (UART)

maintainers:
  - Stephan <linux-qnap-ts228>

description: |
  The TS-228 (RTD1195) routes fan control, system temperature, front-panel
  LEDs, board serial/MAC EEPROM, and AC power-recovery mode through a PIC
  microcontroller on UART1 (/dev/ttyS1 at 19200 8N1), not the SoC PWM block.

  Fan speed is set with single-byte commands 0x30..0x34. Fan RPM and board
  temperature are read with a 0xf6/0xaa framed query using 0xf7 and 0xf8.

  LED commands (stock se_sys_set_*_led PIC backend). Status is one bi-color
  LED::

    status: off 0x59; green 0x56; red 0x57; blink 0x58
    USB on 0x60; blink 0x61; off 0x62

  EEPROM (0xf6 sync, then 0xa1 read / 0xa0 write + offset + length)::

    MAC ASCII at offset 0x10 (18 bytes)
    Board SN ("SN:…") at offset 0x38 (24 bytes)

  Power recovery: 0x48 (modes 0/2), 0x49 (mode 3).
  Buzzer: short 0x50, long 0x51 (vendor QNAP_PIC_BUZZER_*).

  Soft KEY_POWER is not exposed: the front power button does not emit a PIC
  UART event on TS-228 (long-press is handled in PIC hardware).

properties:
  compatible:
    const: qnap,ts228-pic

  fan-0:
    type: object
    additionalProperties: false
    description: Optional thermal cooling map target for the system fan.
    properties:
      cooling-levels:
        description:
          PWM duty values (0-255) mapped to discrete PIC fan levels 0..N-1.
        $ref: /schemas/types.yaml#/definitions/uint32-array
      "#cooling-cells":
        const: 2
    required:
      - cooling-levels
      - "#cooling-cells"

required:
  - compatible

additionalProperties: false

examples:
  - |
    serial {
        compatible = "snps,dw-apb-uart";
        reg = <0x1801b200 0x100>;
        status = "okay";

        pic {
            compatible = "qnap,ts228-pic";

            fan-0 {
                cooling-levels = <0 64 128 192 255>;
                #cooling-cells = <2>;
            };
        };
    };
```

## Documentation/devicetree/bindings/i2c/realtek,rtd1195-i2c.yaml
```yaml
# SPDX-License-Identifier: (GPL-2.0-only OR BSD-2-Clause)
%YAML 1.2
---
$id: http://devicetree.org/schemas/i2c/realtek,rtd1195-i2c.yaml#
$schema: http://devicetree.org/meta-schemas/core.yaml#

title: Realtek RTD1195 I2C controller

maintainers:
  - Stephan Eicher <stephan.eicher@web.de>

description:
  The RTD1195 has seven of these controllers, two in the ISO register block
  and five in MISC. Each reports its interrupt through the SoC's interrupt
  multiplexer rather than directly to the GIC, so the node's interrupt
  parent is that multiplexer and its interrupt specifier has two cells.

allOf:
  - $ref: /schemas/i2c/i2c-controller.yaml#

properties:
  compatible:
    const: realtek,rtd1195-i2c

  reg:
    maxItems: 1

  interrupts:
    maxItems: 1

  clocks:
    maxItems: 1

  resets:
    maxItems: 1

  clock-frequency:
    default: 100000

required:
  - compatible
  - reg
  - interrupts
  - clocks
  - resets

unevaluatedProperties: false

examples:
  - |
    i2c@1801b900 {
        compatible = "realtek,rtd1195-i2c";
        reg = <0x1801b900 0x400>;
        interrupt-parent = <&mux_intc>;
        interrupts = <0 23>;
        #address-cells = <1>;
        #size-cells = <0>;
        clocks = <&clk_en_2 14>;
        resets = <&reset2 24>;

        rtc@32 {
            compatible = "epson,rx8010";
            reg = <0x32>;
        };
    };
```

## Documentation/devicetree/bindings/interrupt-controller/realtek,rtd1195-irq-mux.yaml
```yaml
# SPDX-License-Identifier: (GPL-2.0-only OR BSD-2-Clause)
%YAML 1.2
---
$id: http://devicetree.org/schemas/interrupt-controller/realtek,rtd1195-irq-mux.yaml#
$schema: http://devicetree.org/meta-schemas/core.yaml#

title: Realtek RTD1195 interrupt mux

maintainers:
  - Stephan Eicher <stephan.eicher@web.de>

description:
  Two register blocks on the RTD1195, MISC_TOP and MISC_ISO, each gather up
  to 32 peripheral interrupts onto a single GIC line. Which register in a
  block carries the status and which the enable mask is fixed by the SoC and
  is known to the driver, so it is not described here.

properties:
  compatible:
    const: realtek,rtd1195-irq-mux

  reg:
    items:
      - description: MISC_TOP block
      - description: MISC_ISO block

  reg-names:
    items:
      - const: misc
      - const: iso

  interrupts:
    description: parent interrupt of each block, in the same order as reg
    minItems: 2
    maxItems: 2

  interrupt-controller: true

  "#interrupt-cells":
    const: 2
    description: |
      First cell is the block, 0 for MISC_TOP and 1 for MISC_ISO. Second
      cell is the bit within that block's 32-bit status register.

required:
  - compatible
  - reg
  - interrupts
  - interrupt-controller
  - "#interrupt-cells"

additionalProperties: false

examples:
  - |
    interrupt-controller@1801b000 {
        compatible = "realtek,rtd1195-irq-mux";
        reg = <0x1801b000 0x100>, <0x18007000 0x100>;
        reg-names = "misc", "iso";
        interrupts = <0 40 4>, <0 41 4>;
        interrupt-controller;
        #interrupt-cells = <2>;
    };
```

## Documentation/devicetree/bindings/nvmem/realtek,rtd1195-efuse.yaml
```yaml
# SPDX-License-Identifier: (GPL-2.0-only OR BSD-2-Clause)
%YAML 1.2
---
$id: http://devicetree.org/schemas/nvmem/realtek,rtd1195-efuse.yaml#
$schema: http://devicetree.org/meta-schemas/core.yaml#

title: Realtek RTD1195 eFuse

maintainers:
  - Stephan Eicher <stephan.eicher@web.de>

description:
  One-time-programmable fuses holding per-part calibration written during
  manufacturing, such as the thermal sensor's correction values and the USB
  PHY's DP/DM trim.

allOf:
  - $ref: nvmem.yaml#

properties:
  compatible:
    const: realtek,rtd1195-efuse

  reg:
    maxItems: 1

required:
  - compatible
  - reg

unevaluatedProperties: false

examples:
  - |
    efuse@18017000 {
        compatible = "realtek,rtd1195-efuse";
        reg = <0x18017000 0x400>;
        read-only;
        #address-cells = <1>;
        #size-cells = <1>;

        thermal-calibration@1 {
            reg = <0x1 0x1>;
        };
    };
```

## Documentation/devicetree/bindings/phy/realtek,rtd1195-rle0599-usb2phy.yaml
```yaml
# SPDX-License-Identifier: (GPL-2.0-only OR BSD-2-Clause)
%YAML 1.2
---
$id: http://devicetree.org/schemas/phy/realtek,rtd1195-rle0599-usb2phy.yaml#
$schema: http://devicetree.org/meta-schemas/core.yaml#

title: Realtek RTD1195 RLE0599 USB 2.0 PHY

maintainers:
  - Stephan Eicher <stephan.eicher@web.de>

description:
  The USB 2.0 PHY attached to the EHCI and OHCI controllers on the Realtek
  RTD1195. It is programmed indirectly: a page and register address are
  written to the wrapper status register, and the transfer is driven through
  the EHCI INSNREG05 register. This is a different access path from the PHY
  on the DWC3 controller, which is reached through GUSB2PHYACC0 and is
  described by realtek,usb2phy.yaml instead.

properties:
  compatible:
    const: realtek,rtd1195-rle0599-usb2phy

  reg:
    items:
      - description: wrapper status register (REG_WRAP_VStatusOut2)
      - description: EHCI indirect access register (REG_EHCI_INSNREG05)

  reg-names:
    items:
      - const: vstatus
      - const: insnreg05

  "#phy-cells":
    const: 0

required:
  - compatible
  - reg
  - "#phy-cells"

additionalProperties: false

examples:
  - |
    usb-phy@18013824 {
        compatible = "realtek,rtd1195-rle0599-usb2phy";
        reg = <0x18013824 0x4>, <0x180130a4 0x4>;
        reg-names = "vstatus", "insnreg05";
        #phy-cells = <0>;
    };
```

## Documentation/devicetree/bindings/soc/realtek/realtek,rtd1195-sb2.yaml
```yaml
# SPDX-License-Identifier: (GPL-2.0-only OR BSD-2-Clause)
%YAML 1.2
---
$id: http://devicetree.org/schemas/soc/realtek/realtek,rtd1195-sb2.yaml#
$schema: http://devicetree.org/meta-schemas/core.yaml#

title: Realtek RTD1195 system bus 2 (SB2) debug unit

maintainers:
  - Stephan Eicher <stephan.eicher@web.de>

description:
  Reports and logs bus errors (invalid access, memory trash detection)
  raised on the SoC's internal SB2 bus fabric. This is a debug facility,
  not a hardware semaphore or locking primitive.

properties:
  compatible:
    enum:
      - realtek,rtd1195-sb2
      - realtek,sysbrg2

  reg:
    maxItems: 1

  interrupts:
    maxItems: 1

required:
  - compatible
  - reg
  - interrupts

additionalProperties: false

examples:
  - |
    #include <dt-bindings/interrupt-controller/arm-gic.h>
    sb2@0 {
        compatible = "realtek,rtd1195-sb2";
        reg = <0x0 0x900>;
        interrupts = <GIC_SPI 36 IRQ_TYPE_LEVEL_HIGH>;
    };
```

## Documentation/devicetree/bindings/soc/realtek/realtek,rtd1195-scpu-sramctl.yaml
```yaml
# SPDX-License-Identifier: (GPL-2.0-only OR BSD-2-Clause)
%YAML 1.2
---
$id: http://devicetree.org/schemas/soc/realtek/realtek,rtd1195-scpu-sramctl.yaml#
$schema: http://devicetree.org/meta-schemas/core.yaml#

title: Realtek RTD1195 SCPU SRAM control

maintainers:
  - Stephan Eicher <stephan.eicher@web.de>

description:
  Timing control for the CPU cluster's SRAM. It has to be adjusted when
  the CPU PLL rate changes.

properties:
  compatible:
    const: realtek,rtd1195-scpu-sramctl

  reg:
    maxItems: 1

required:
  - compatible
  - reg

additionalProperties: false

examples:
  - |
    sramctl@1801d000 {
        compatible = "realtek,rtd1195-scpu-sramctl";
        reg = <0x1801d000 0x4>;
    };
```

## Documentation/devicetree/bindings/thermal/realtek,rtd1195-thermal-sensor.yaml
```yaml
# SPDX-License-Identifier: (GPL-2.0-only OR BSD-2-Clause)
%YAML 1.2
---
$id: http://devicetree.org/schemas/thermal/realtek,rtd1195-thermal-sensor.yaml#
$schema: http://devicetree.org/meta-schemas/core.yaml#

title: Realtek RTD1195 thermal sensor

maintainers:
  - Stephan Eicher <stephan.eicher@web.de>

description:
  On-die temperature sensor. The reading is corrected with two calibration
  values programmed into the SoC eFuse during manufacturing.

properties:
  compatible:
    const: realtek,rtd1195-thermal-sensor

  reg:
    items:
      - description: sensor control register
      - description: sensor status register

  "#thermal-sensor-cells":
    const: 0

  nvmem-cells:
    items:
      - description: first calibration value
      - description: second calibration value

  nvmem-cell-names:
    items:
      - const: calibration0
      - const: calibration1

required:
  - compatible
  - reg
  - "#thermal-sensor-cells"

additionalProperties: false

examples:
  - |
    thermal-sensor@18000310 {
        compatible = "realtek,rtd1195-thermal-sensor";
        reg = <0x18000310 0x4>, <0x18000314 0x4>;
        #thermal-sensor-cells = <0>;
        nvmem-cells = <&tcal0>, <&tcal1>;
        nvmem-cell-names = "calibration0", "calibration1";
    };
```

## Documentation/devicetree/bindings/timer/realtek,rtd1195-timer.yaml
```yaml
# SPDX-License-Identifier: (GPL-2.0-only OR BSD-2-Clause)
%YAML 1.2
---
$id: http://devicetree.org/schemas/timer/realtek,rtd1195-timer.yaml#
$schema: http://devicetree.org/meta-schemas/core.yaml#

title: Realtek RTD1195 timer

maintainers:
  - Stephan Eicher <stephan.eicher@web.de>

description:
  The RTD1195 timer block holds several 32-bit counters sharing one register
  window. Two of them have an interrupt of their own and are used as the tick
  device of one CPU each; a third free-running counter provides the
  clocksource and sched_clock.

properties:
  compatible:
    const: realtek,rtd1195-timer

  reg:
    maxItems: 1

  interrupts:
    description:
      One per timer channel usable as a tick device, in channel order. The
      first is given to CPU0 and the second to CPU1.
    minItems: 2
    maxItems: 2

  clocks:
    maxItems: 1

  clock-frequency:
    description:
      Counter input frequency, for device trees that do not describe the
      clock. Ignored when "clocks" is present.

required:
  - compatible
  - reg
  - interrupts

anyOf:
  - required: [clocks]
  - required: [clock-frequency]

additionalProperties: false

examples:
  - |
    timer@1801b000 {
        compatible = "realtek,rtd1195-timer";
        reg = <0x1801b000 0x600>;
        interrupts = <0 17 4>, <0 18 4>;
        clocks = <&osc27M>;
    };
```
